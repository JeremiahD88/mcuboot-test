## build/Kconfig/soc/Kconfig
```kconfig
# Load Zephyr SoC Kconfig descriptions.
osource "/home/jerdan/mcuboot-workspace/zephyr/soc/xlnx/zynqmp/Kconfig"
osource "/home/jerdan/mcuboot-workspace/zephyr/soc/xlnx/zynq7000/Kconfig"
osource "/home/jerdan/mcuboot-workspace/zephyr/soc/xen/Kconfig"
osource "/home/jerdan/mcuboot-workspace/zephyr/soc/ti/simplelink/Kconfig"
osource "/home/jerdan/mcuboot-workspace/zephyr/soc/ti/lm3s6965/Kconfig"
osource "/home/jerdan/mcuboot-workspace/zephyr/soc/ti/k3/Kconfig"
osource "/home/jerdan/mcuboot-workspace/zephyr/soc/telink/tlsr/Kconfig"
osource "/home/jerdan/mcuboot-workspace/zephyr/soc/starfive/jh71xx/Kconfig"
osource "/home/jerdan/mcuboot-workspace/zephyr/soc/st/stm32/Kconfig"
osource "/home/jerdan/mcuboot-workspace/zephyr/soc/snps/qemu_arc/Kconfig"
osource "/home/jerdan/mcuboot-workspace/zephyr/soc/snps/nsim/arc_v/Kconfig"
osource "/home/jerdan/mcuboot-workspace/zephyr/soc/snps/nsim/arc_classic/Kconfig"
osource "/home/jerdan/mcuboot-workspace/zephyr/soc/snps/hsdk4xd/Kconfig"
osource "/home/jerdan/mcuboot-workspace/zephyr/soc/snps/hsdk/Kconfig"
osource "/home/jerdan/mcuboot-workspace/zephyr/soc/snps/emsk/Kconfig"
osource "/home/jerdan/mcuboot-workspace/zephyr/soc/snps/emsdp/Kconfig"
osource "/home/jerdan/mcuboot-workspace/zephyr/soc/snps/arc_iot/Kconfig"
osource "/home/jerdan/mcuboot-workspace/zephyr/soc/silabs/Kconfig"
osource "/home/jerdan/mcuboot-workspace/zephyr/soc/sifive/sifive_freedom/Kconfig"
osource "/home/jerdan/mcuboot-workspace/zephyr/soc/rockchip/Kconfig"
osource "/home/jerdan/mcuboot-workspace/zephyr/soc/renode/riscv_virtual/Kconfig"
osource "/home/jerdan/mcuboot-workspace/zephyr/soc/renesas/smartbond/Kconfig"
osource "/home/jerdan/mcuboot-workspace/zephyr/soc/renesas/rzt2m/Kconfig"
osource "/home/jerdan/mcuboot-workspace/zephyr/soc/renesas/rcar/Kconfig"
osource "/home/jerdan/mcuboot-workspace/zephyr/soc/renesas/ra/Kconfig"
osource "/home/jerdan/mcuboot-workspace/zephyr/soc/raspberrypi/Kconfig"
osource "/home/jerdan/mcuboot-workspace/zephyr/soc/quicklogic/eos_s3/Kconfig"
osource "/home/jerdan/mcuboot-workspace/zephyr/soc/qemu/virt_riscv/Kconfig"
osource "/home/jerdan/mcuboot-workspace/zephyr/soc/qemu/malta/Kconfig"
osource "/home/jerdan/mcuboot-workspace/zephyr/soc/openisa/rv32m1/Kconfig"
osource "/home/jerdan/mcuboot-workspace/zephyr/soc/nxp/s32/Kconfig"
osource "/home/jerdan/mcuboot-workspace/zephyr/soc/nxp/rw/Kconfig"
osource "/home/jerdan/mcuboot-workspace/zephyr/soc/nxp/mcx/Kconfig"
osource "/home/jerdan/mcuboot-workspace/zephyr/soc/nxp/lpc/Kconfig"
osource "/home/jerdan/mcuboot-workspace/zephyr/soc/nxp/layerscape/Kconfig"
osource "/home/jerdan/mcuboot-workspace/zephyr/soc/nxp/kinetis/Kconfig"
osource "/home/jerdan/mcuboot-workspace/zephyr/soc/nxp/imxrt/Kconfig"
osource "/home/jerdan/mcuboot-workspace/zephyr/soc/nxp/imx/Kconfig"
osource "/home/jerdan/mcuboot-workspace/zephyr/soc/nuvoton/numicro/Kconfig"
osource "/home/jerdan/mcuboot-workspace/zephyr/soc/nuvoton/numaker/Kconfig"
osource "/home/jerdan/mcuboot-workspace/zephyr/soc/nuvoton/npcx/Kconfig"
osource "/home/jerdan/mcuboot-workspace/zephyr/soc/nuvoton/npcm/Kconfig"
osource "/home/jerdan/mcuboot-workspace/zephyr/soc/nordic/Kconfig"
osource "/home/jerdan/mcuboot-workspace/zephyr/soc/neorv32/Kconfig"
osource "/home/jerdan/mcuboot-workspace/zephyr/soc/native/inf_clock/Kconfig"
osource "/home/jerdan/mcuboot-workspace/zephyr/soc/microchip/miv/Kconfig"
osource "/home/jerdan/mcuboot-workspace/zephyr/soc/microchip/mec/Kconfig"
osource "/home/jerdan/mcuboot-workspace/zephyr/soc/mediatek/mtk_adsp/Kconfig"
osource "/home/jerdan/mcuboot-workspace/zephyr/soc/lowrisc/opentitan/Kconfig"
osource "/home/jerdan/mcuboot-workspace/zephyr/soc/litex/litex_vexriscv/Kconfig"
osource "/home/jerdan/mcuboot-workspace/zephyr/soc/ite/ec/Kconfig"
osource "/home/jerdan/mcuboot-workspace/zephyr/soc/intel/raptor_lake/Kconfig"
osource "/home/jerdan/mcuboot-workspace/zephyr/soc/intel/lakemont/Kconfig"
osource "/home/jerdan/mcuboot-workspace/zephyr/soc/intel/intel_socfpga_std/Kconfig"
osource "/home/jerdan/mcuboot-workspace/zephyr/soc/intel/intel_socfpga/Kconfig"
osource "/home/jerdan/mcuboot-workspace/zephyr/soc/intel/intel_niosv/Kconfig"
osource "/home/jerdan/mcuboot-workspace/zephyr/soc/intel/intel_ish/Kconfig"
osource "/home/jerdan/mcuboot-workspace/zephyr/soc/intel/intel_adsp/Kconfig"
osource "/home/jerdan/mcuboot-workspace/zephyr/soc/intel/elkhart_lake/Kconfig"
osource "/home/jerdan/mcuboot-workspace/zephyr/soc/intel/atom/Kconfig"
osource "/home/jerdan/mcuboot-workspace/zephyr/soc/intel/apollo_lake/Kconfig"
osource "/home/jerdan/mcuboot-workspace/zephyr/soc/intel/alder_lake/Kconfig"
osource "/home/jerdan/mcuboot-workspace/zephyr/soc/infineon/cat3/Kconfig"
osource "/home/jerdan/mcuboot-workspace/zephyr/soc/infineon/cat1b/Kconfig"
osource "/home/jerdan/mcuboot-workspace/zephyr/soc/infineon/cat1a/Kconfig"
osource "/home/jerdan/mcuboot-workspace/zephyr/soc/gd/gd32/Kconfig"
osource "/home/jerdan/mcuboot-workspace/zephyr/soc/gaisler/leon3/Kconfig"
osource "/home/jerdan/mcuboot-workspace/zephyr/soc/gaisler/gr716a/Kconfig"
osource "/home/jerdan/mcuboot-workspace/zephyr/soc/espressif/Kconfig"
osource "/home/jerdan/mcuboot-workspace/zephyr/soc/ene/kb1200/Kconfig"
osource "/home/jerdan/mcuboot-workspace/zephyr/soc/efinix/sapphire/Kconfig"
osource "/home/jerdan/mcuboot-workspace/zephyr/soc/cdns/xtensa_sample_controller/Kconfig"
osource "/home/jerdan/mcuboot-workspace/zephyr/soc/cdns/dc233c/Kconfig"
osource "/home/jerdan/mcuboot-workspace/zephyr/soc/brcm/bcmvk/Kconfig"
osource "/home/jerdan/mcuboot-workspace/zephyr/soc/brcm/bcm2712/Kconfig"
osource "/home/jerdan/mcuboot-workspace/zephyr/soc/brcm/bcm2711/Kconfig"
osource "/home/jerdan/mcuboot-workspace/zephyr/soc/atmel/sam0/Kconfig"
osource "/home/jerdan/mcuboot-workspace/zephyr/soc/atmel/sam/Kconfig"
osource "/home/jerdan/mcuboot-workspace/zephyr/soc/aspeed/Kconfig"
osource "/home/jerdan/mcuboot-workspace/zephyr/soc/arm/Kconfig"
osource "/home/jerdan/mcuboot-workspace/zephyr/soc/arm/beetle/Kconfig"
osource "/home/jerdan/mcuboot-workspace/zephyr/soc/andestech/Kconfig"
osource "/home/jerdan/mcuboot-workspace/zephyr/soc/ambiq/Kconfig"
osource "/home/jerdan/mcuboot-workspace/zephyr/soc/altr/zephyr_nios2f/Kconfig"
osource "/home/jerdan/mcuboot-workspace/zephyr/soc/altr/qemu_nios2/Kconfig"
osource "/home/jerdan/mcuboot-workspace/zephyr/soc/adi/max32/Kconfig"
```

## build_test/Kconfig/arch/Kconfig
```kconfig
# Load arch Kconfig descriptions.
osource "/home/jeremiah/mcuboot-workspace/zephyr/arch/x86/Kconfig"
osource "/home/jeremiah/mcuboot-workspace/zephyr/arch/xtensa/Kconfig"
osource "/home/jeremiah/mcuboot-workspace/zephyr/arch/sparc/Kconfig"
osource "/home/jeremiah/mcuboot-workspace/zephyr/arch/riscv/Kconfig"
osource "/home/jeremiah/mcuboot-workspace/zephyr/arch/posix/Kconfig"
osource "/home/jeremiah/mcuboot-workspace/zephyr/arch/nios2/Kconfig"
osource "/home/jeremiah/mcuboot-workspace/zephyr/arch/mips/Kconfig"
osource "/home/jeremiah/mcuboot-workspace/zephyr/arch/arm64/Kconfig"
osource "/home/jeremiah/mcuboot-workspace/zephyr/arch/arm/Kconfig"
osource "/home/jeremiah/mcuboot-workspace/zephyr/arch/arc/Kconfig"
```
